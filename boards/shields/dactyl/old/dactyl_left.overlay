#include "dactyl.dtsi" // The shared dtsi file is included in the overlay

&physical_layout0 {
    kscan = <&kscan0>; // Label of the kscan node this layout uses
    transform = <&default_transform>; // Label of the matrix transform this layout uses
};


//&kscan0 {};